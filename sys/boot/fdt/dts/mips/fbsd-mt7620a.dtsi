/* $FreeBSD: stable/11/sys/boot/fdt/dts/mips/fbsd-mt7620a.dtsi 300013 2016-05-17 06:42:24Z sgalabov $ */

&pcie {
	/*
	 * Our driver is different that OpenWRT's, so we need slightly
	 * different values for the reg property
	 */
	reg = <0x10140000 0x10000>;
};
